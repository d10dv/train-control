## components/debug_log/Kconfig
```kconfig
menu "Debug Logging"
    config DLOG_ENABLE_STRUCTURED
        bool "Enable structured log format"
        default y
        help
            When enabled, log output includes structured fields
            (timestamp, tag, severity).

    config DLOG_ENABLE_MQTT_TRANSPORT
        bool "Publish logs to MQTT topic"
        default n
        help
            When enabled, log messages are also published to
            the MQTT topic "train/log".
endmenu
```

## components/display/Kconfig
```kconfig
menu "Display"

    config DISPLAY_PIN_SDA
        int "SDA GPIO"
        default 22

    config DISPLAY_PIN_SCL
        int "SCL GPIO"
        default 19

    config DISPLAY_PIN_RST
        int "RST (Reset) GPIO (-1 to disable)"
        default -1
        range -1 39

    config DISPLAY_I2C_FREQ_HZ
        int "I2C clock frequency (Hz)"
        default 400000
        range 100000 1000000

endmenu
```

## components/input_manager/Kconfig
```kconfig
menu "Input Manager"
    config INPUT_DEBOUNCE_MS
        int "Button debounce time (ms)"
        default 50
        range 10 500
        help
            Debounce period for button inputs in milliseconds.

    config INPUT_LONG_PRESS_MS
        int "Long press threshold (ms)"
        default 1000
        range 200 5000
        help
            Time a button must be held to trigger a long press event.

    config INPUT_ENCODER_USE_PCNT
        bool "Use PCNT peripheral for encoders"
        default y
        help
            Use the hardware pulse counter (PCNT) peripheral for
            quadrature decoding. Falls back to GPIO ISR if disabled.
endmenu
```

## components/mqtt_broker/Kconfig
```kconfig
menu "MQTT Broker"
    config MQTT_BROKER_PORT
        int "Broker listen port"
        default 1883
        help
            TCP port for the MQTT broker to listen on.

    config MQTT_BROKER_MAX_CLIENTS
        int "Max concurrent MQTT clients"
        default 8
        range 1 16
        help
            Maximum number of MQTT clients connected simultaneously.

    config MQTT_BROKER_MAX_SUBSCRIPTIONS
        int "Max total subscriptions"
        default 32
        range 1 128
        help
            Maximum number of topic subscriptions across all clients.
endmenu
```

## components/wifi_ap/Kconfig
```kconfig
menu "WiFi Access Point"
    config WIFI_AP_SSID
        string "AP SSID"
        default "TrainControl"
        help
            SSID (network name) of the WiFi access point.

    config WIFI_AP_PASSWORD
        string "AP Password"
        default "train1234"
        help
            Password for the WiFi access point.
            Must be at least 8 characters for WPA2.

    config WIFI_AP_CHANNEL
        int "WiFi Channel"
        default 6
        range 1 13
        help
            WiFi channel for the access point.

    config WIFI_AP_MAX_CONNECTIONS
        int "Max Stations"
        default 4
        range 1 10
        help
            Maximum number of stations that can connect simultaneously.
endmenu
```

## sdkconfig.defaults
```kconfig
# Serial flasher config
CONFIG_ESPTOOLPY_FLASHSIZE_4MB=y

# FreeRTOS
CONFIG_FREERTOS_HZ=1000

# Log level
CONFIG_LOG_DEFAULT_LEVEL_INFO=y

# WiFi AP defaults
CONFIG_WIFI_AP_SSID="TrainControl"
CONFIG_WIFI_AP_PASSWORD="train1234"
CONFIG_WIFI_AP_CHANNEL=6
CONFIG_WIFI_AP_MAX_CONNECTIONS=4

# MQTT Broker defaults
CONFIG_MQTT_BROKER_PORT=1883
CONFIG_MQTT_BROKER_MAX_CLIENTS=8
CONFIG_MQTT_BROKER_MAX_SUBSCRIPTIONS=32

# Input Manager defaults
CONFIG_INPUT_DEBOUNCE_MS=50
CONFIG_INPUT_LONG_PRESS_MS=1000
CONFIG_INPUT_ENCODER_USE_PCNT=y

# Display (SSD1306 I2C OLED 128x64)
CONFIG_DISPLAY_PIN_SDA=22
CONFIG_DISPLAY_PIN_SCL=19
CONFIG_DISPLAY_PIN_RST=-1
CONFIG_DISPLAY_I2C_FREQ_HZ=400000

# Debug Log
CONFIG_DLOG_ENABLE_STRUCTURED=y
```
